## drivers/oneplus/Kconfig
```kconfig
source "drivers/oneplus/coretech/Kconfig"
source "drivers/oneplus/input/Kconfig"
source "drivers/oneplus/misc/Kconfig"
source "drivers/oneplus/tri_state_key/Kconfig"
source "drivers/oneplus/power/Kconfig"
source "drivers/oneplus/vibrator/Kconfig"
source "drivers/oneplus/vl53L1/Kconfig"
```

## drivers/oneplus/coretech/Kconfig
```kconfig
config HOUSTON
	default n
	bool "to collect system-wide and pmu data"
	help
	 Realtime temperature monitor
```

## drivers/oneplus/misc/Kconfig
```kconfig
config PARAM_READ_WRITE
	bool "Param partition read/write support"
	default n
	help
		if you want to read/write the param partition in kernel,
		then you must say Y here.

config PROJECT_INFO
    bool "detect project info"
    default n
    help
      detect projcet info  If unsure, say n.

config OEM_BOOT_MODE
    bool "detect oem boot mode"
    default n
    help
        detect oem boot mode  If unsure, say y.

config RF_CABLE_DETECT
    bool "detect RF cable connection"
    help
      detect RF cable connection for different RF configuration
      To compile this driver as a module, choose M here: the module
      will be called RF cable.
      If unsure, say N.

config GPIO_SWITCH
	tristate "use gpio swith"
	default y
	help
	  we can use gpio switch set gpio out high or low

config REGULATOR_DEMO
	tristate "use regultor demo"
	default y
	help
	  we can use regulator demo to control regulator
```
